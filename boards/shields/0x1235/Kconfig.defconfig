## boards/shields/0x1235/Kconfig.defconfig
```kconfig
if SHIELD_0X1235_LEFT || SHIELD_0X1235_RIGHT

  config ZMK_SPLIT
    default y

endif


if SHIELD_0X1235_LEFT

  config ZMK_SPLIT_ROLE_CENTRAL
    default y

  config ZMK_KEYBOARD_NAME
    default "0x1235"

endif
  

if SHIELD_0X1235_RIGHT

  config ZMK_KEYBOARD_NAME
    default "0x1235"

endif

if SHIELD_0X1235_LEFT || SHIELD_0X1235_RIGHT

  config ZMK_DISPLAY
    default y
  
  config ZMK_WIDGET_BATTERY_STATUS_SHOW_PERCENTAGE
    default y
    
  config ZMK_WIDGET_WPM_STATUS
    default y

endif
```

## boards/shields/0x1235/Kconfig.shield
```kconfig
config SHIELD_0X1235_LEFT
  def_bool $(shields_list_contains, 0x1235_left)

config SHIELD_0X1235_RIGHT
  def_bool $(shields_list_contains, 0x1235_right)
```

## boards/shields/acrone/Kconfig.defconfig
```kconfig
if SHIELD_ACRONE_LEFT || SHIELD_ACRONE_RIGHT

  config ZMK_SPLIT
    default y

endif


if SHIELD_ACRONE_LEFT

  config ZMK_SPLIT_ROLE_CENTRAL
    default y

  config ZMK_KEYBOARD_NAME
    default "acrone.central"

endif
  

if SHEILD_ACRONE_RIGHT

  config ZMK_KEYBOARD_NAME
    default "acrone.right"

endif
```

## boards/shields/acrone/Kconfig.shield
```kconfig
config SHIELD_ACRONE_LEFT
  def_bool $(shields_list_contains, acrone_left)

config SHIELD_ACRONE_RIGHT
  def_bool $(shields_list_contains, acrone_right)
```
